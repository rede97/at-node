## esp32/zephyr/boards/muselab/nano_esp32s3/Kconfig
```kconfig
# Copyright (c) 2026 MuseLab nanoESP32-S3 Zephyr port
# SPDX-License-Identifier: Apache-2.0

config HEAP_MEM_POOL_ADD_SIZE_BOARD
	int
	default 4096 if BOARD_NANO_ESP32S3_ESP32S3_PROCPU
```

## esp32/zephyr/boards/muselab/nano_esp32s3/Kconfig.nano_esp32s3
```kconfig
# Copyright (c) 2026 MuseLab nanoESP32-S3 Zephyr port
# SPDX-License-Identifier: Apache-2.0

config BOARD_NANO_ESP32S3
	select SOC_ESP32S3_WROOM_N8R8
	select SOC_ESP32S3_PROCPU if BOARD_NANO_ESP32S3_ESP32S3_PROCPU
```

## esp32/zephyr/boards/muselab/nano_esp32s3/Kconfig.sysbuild
```kconfig
# Copyright (c) 2026 MuseLab nanoESP32-S3 Zephyr port
# SPDX-License-Identifier: Apache-2.0

choice BOOTLOADER
	default BOOTLOADER_MCUBOOT
endchoice

choice BOOT_SIGNATURE_TYPE
	default BOOT_SIGNATURE_TYPE_NONE
endchoice
```

## esp32/zephyr/boards/muselab/nano_esp32s3/board.yml
```yaml
board:
  name: nano_esp32s3
  full_name: nanoESP32-S3
  vendor: muselab
  socs:
    - name: esp32s3
```
